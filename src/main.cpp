// 3 channel Video Diversity Controller v1.1
// selects the best video signal, based on the detection
// of line sync. pulses (coming from using LM1881 chpis).
// The souce with the most 'regular' pulses (in the last few hundered lines)
// is chosen.
//
// Hardware:
//    - Wemos D1 mini clone (ESP8266) running at 160Mhz
//    - Video switch: Max4545
//      (allows to commute 4 sources -- but code is here for 3 sources)
//    - 3 LM1881, to generate the line sync. pulses
//
// https://randomnerdtutorials.com/esp8266-pinout-reference-gpios/
// ====================================================================

#include <Arduino.h>
#include <ESP8266WiFi.h>
#include "user_interface.h"
#include <SPI.h>
#include <Wire.h>
#include <Adafruit_GFX.h>
#include <Adafruit_SSD1306.h>
#include <Adafruit_I2CDevice.h>

const String PROJECT_NAME_LN1 = "3-Channel Diversity";
const String PROJECT_NAME_LN2 = "Controller ";
const String VERSION = "v1.2";
const String CREATOR = "github/jharwinbarrozo";

const int I2C_DISPLAY_ADDRESS = 0x3C;
#define ENABLED_OLED
#define SCREEN_WIDTH 128 // OLED display width, in pixels
#define SCREEN_HEIGHT 64 // OLED display height, in pixels

// flux_logo, 128x64px
const unsigned char fluxLogo [] PROGMEM = {
	0x00, 0x00, 0x00, 0x00, 0x00, 0x00, 0x00, 0x00, 0x00, 0x00, 0x00, 0x00, 0x00, 0x00, 0x00, 0x00, 
	0x00, 0x00, 0x00, 0x00, 0x00, 0x00, 0x00, 0x00, 0x00, 0x00, 0x00, 0x00, 0x00, 0x00, 0x00, 0x00, 
	0x00, 0x1f, 0xff, 0xff, 0xff, 0xff, 0xff, 0xff, 0xff, 0xff, 0xff, 0xff, 0xff, 0xff, 0xf8, 0x00, 
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	0x00, 0x00, 0x00, 0x00, 0x00, 0x00, 0x00, 0x00, 0x00, 0x00, 0x00, 0x00, 0x00, 0x00, 0x00, 0x00
};

// Declaration for an SSD1306 display connected to I2C (SDA, SCL pins)
#define OLED_RESET     -1 // Reset pin # (or -1 if sharing Arduino reset pin)
Adafruit_SSD1306 display(SCREEN_WIDTH, SCREEN_HEIGHT, &Wire, OLED_RESET);

#define N 500

//Pin connected to the LM1881 sync outputs (INPUTS for mcu)
#define PIN_SyncA D2 // BPOUT1
#define PIN_SyncB D7 // BPOUT2
#define PIN_SyncC D4 // BPOUT3

//Pin connected to the MAX4545 (switch) pin that selects the desired source (OUTPUT for MCU)
#define PIN_selectA D1 // IN1
#define PIN_selectB D5 // IN2
#define PIN_selectC D6 // IN3

// keyword "Volatile" means that this variable may be changed by a routine called by some interrupt.
volatile unsigned long lastA; // Time of the last sync signal
volatile unsigned long lastB; // Time of the last sync signal
volatile unsigned long lastC; // Time of the last sync signal

unsigned long now;

#define t0 63
const long unsigned mus = t0 * N; // Period to update the selected source, in micro sec.
const long unsigned mis = mus / 1000; // same as above, in milli sec.

#define sourceA 0
#define sourceB 1
#define sourceC 2
int selected;
unsigned long lastMillis;

//-----------------------------------------------------------------
class ExpAverage {
  private:
    volatile float x;
    const float a, b;
  public:
    ExpAverage(int n): a(1.0f / n), b(1.0f - a) { // exponential average over the ~n previous values
      x = 0.0f;
    }
    inline float getAverage() {
      return x;
    }
    void addValue(unsigned long v) {
      x = a * v + b * x;
    }
};

//------------------------------------------------------------------------
ExpAverage A(N), B(N), C(N);// Average video line duration for the different sources
#ifdef ENABLED_OLED
ExpAverage AA(N), BB(N), CC(N);// Average video line duration for the different sources
#endif
//------------------------------------------------------------------------

//------------------------------------------------------------------------
const int CLEAR = (1 << PIN_selectA) + (1 << PIN_selectB) + (1 << PIN_selectC);
int Bin[3] = {1 << PIN_selectA , 1 << PIN_selectB, 1 << PIN_selectC};
inline void SwitchTo(int s) {
  if (selected != s) {
    selected = s;
    GPOC = CLEAR;//Clear PIN_selectA, PIN_selectB and PIN_selectC simultaneously
    GPOS = Bin[s];
  }
}
//------------------------------------------------------------------------

//------------------------------------------------------------------------
class PeriodicTask {
  private:
    os_timer_t myTimer;
    int t;
  public:
    //---------------------------------------------------------------------
    static void DoTask(void *pArg) {//static needed here, because below we want to pass a pointer to this member function
      const unsigned long  now = micros();
      if (now - lastA > mus) {
        //if no pulse was received since last update, put the value 'mus' into the average
        //... so, if no pulse is received at all (disconnected cable, etc.à, the average line duration will be 'mus=N*64' (very large compared to 64) so this
        // source will not be selected.
        A.addValue(mus); lastA = now;
      }
      if (now - lastB > mus) B.addValue(mus), lastB = now;
      if (now - lastC > mus) C.addValue(mus), lastC = now;

      //Get the average deviation (from ~63 micro seconds) of the line durations
      const float avA = A.getAverage();
      const float avB = B.getAverage();
      const float avC = C.getAverage();

      if (avB < avA) {
        //The best is B or C
        if (avC < avB)
        {
          SwitchTo(sourceC);
        }
        else {
          SwitchTo(sourceB);
        }

      } else {//The best is A or C
        if (avA < avC)
          SwitchTo(sourceA); else {
            SwitchTo(sourceC);
          }
      }
    }
    //----------------------------------------------------------------
    PeriodicTask () {
      os_timer_setfn(&myTimer, DoTask, NULL);
    }
    void Start(int t, bool repeat = true) {
      os_timer_arm(&myTimer, t, repeat);
    }
};
PeriodicTask T;

//----------------------------Count-------------------------------------
IRAM_ATTR void CountA() {
  const unsigned long  now = micros();
  const long period = now - lastA;
  lastA = now;
  A.addValue(abs(period - t0));
#ifdef ENABLED_OLED
  AA.addValue(period);
#endif
}
IRAM_ATTR void CountB() {
  const unsigned long now = micros();
  const long period = now - lastB;
  lastB = now;
  B.addValue(abs(period - t0));
#ifdef ENABLED_OLED
  BB.addValue(period);
#endif
}
IRAM_ATTR void CountC() {
  const unsigned long now = micros();
  const long period = now - lastC;
  lastC = now;
  C.addValue(abs(period - t0));
#ifdef ENABLED_OLED
  CC.addValue(period);
#endif
}
//-----------------------------Setup------------------------------------

void setup() {
 WiFi.mode(WIFI_OFF);
 WiFi.forceSleepBegin();

#ifdef ENABLED_OLED
// To change the default i2c pins (SDA D2, SCL D1) to TX (gpio1) and RX (gpio3)
// Wire.begin(sda int, scl int);
  Wire.begin(1,3);

  // SSD1306_SWITCHCAPVCC = generate display voltage from 3.3V internally
  if(!display.begin(SSD1306_SWITCHCAPVCC, I2C_DISPLAY_ADDRESS)) {
    for(;;); // Don't proceed, loop forever
  }
  // Display start up..
  display.clearDisplay();
  display.setTextSize(1.2);
  display.setTextColor(SSD1306_WHITE);
  display.drawRect(0,0,128,36,WHITE);
  display.setCursor(8,9);  
  display.print(PROJECT_NAME_LN1);
  display.setCursor(20,19);  
  display.print(PROJECT_NAME_LN2);
  display.print(VERSION);
  display.setCursor(0,42);
  display.println("Designed by: ");
  display.setCursor(0,52);
  display.print(CREATOR);
  display.display(); delay(5000);
  display.clearDisplay();
  display.drawBitmap(0, 0, fluxLogo, 128, 64, SSD1306_WHITE);
  display.display();
#endif

  lastA = 0; // Time of the last signal on sensor A
  lastB = 0; // Time of the last signal on sensor B
  lastC = 0; // Time of the last signal on sensor C

  pinMode(PIN_SyncA, INPUT);
  pinMode(PIN_SyncB, INPUT);
  pinMode(PIN_SyncC, INPUT);

  pinMode(PIN_selectA, OUTPUT);
  pinMode(PIN_selectB, OUTPUT);
  pinMode(PIN_selectC, OUTPUT);

  selected = sourceB;
  //Some blinking to start
  for (int i = 0; i < 4; i++) {
    SwitchTo(sourceA); delay(250);
    SwitchTo(sourceB); delay(250);
    SwitchTo(sourceC); delay(250);
  }
  //Declare 3 interrupts, to measure the duration between horizontal sync. pulses
  //on the 3 sources
  attachInterrupt(PIN_SyncA, CountA, FALLING);
  attachInterrupt(PIN_SyncB, CountB, FALLING);
  attachInterrupt(PIN_SyncC, CountC, FALLING);

  T.Start(mis, true); //Start the process that updates the selected source every 'mis' milliseconds (timer-based)
}
//-----------------------------------------------------------------

void loop() {
#ifdef ENABLED_OLED
    const float avAA = AA.getAverage();
    const float avBB = BB.getAverage();
    const float avCC = CC.getAverage();

    //Prints some debug information to the serial output, every 1000 milli sec.
    display.clearDisplay();

    display.setTextColor(SSD1306_WHITE);
    display.setTextSize(1);
    display.setCursor(6,6);
    display.print("ACTIVE");

    // 3 small boxes with border
    display.drawCircle(48, 9, 3, SSD1306_WHITE);
    display.drawCircle(57, 9, 3, SSD1306_WHITE);
    display.drawCircle(66, 9, 3, SSD1306_WHITE);

    // Box wrapper with border
    display.drawRect(0, 0, 75, 52, SSD1306_WHITE);
    
    display.setTextSize(3);
    display.setCursor(5,13);
    display.print("v");
    display.setTextSize(4);
    display.setCursor(24,18);
    display.print("R");
    display.setCursor(49,18);
    display.print("X");

    //solid white wrapper for the huge 1,2,3
    display.fillRect(80, 0, 50, 52, SSD1306_WHITE);
      if (selected == sourceA) {
        //triangle shape to cut the solid box
        display.fillTriangle(118, 0, 128, 0, 128, 10, SSD1306_BLACK);
        display.fillCircle(48, 9, 3, SSD1306_WHITE); // fill for small box
        display.setTextSize(6);
        display.setCursor(89,6);
        display.setTextColor(SSD1306_BLACK);
        display.print("1");
      }
      if (selected == sourceB) {
        //triangle shape to cut the solid box
        display.fillTriangle(118, 0, 128, 0, 128, 10, SSD1306_BLACK);
        display.fillCircle(57, 9, 3, SSD1306_WHITE); // fill for small box
        display.setTextSize(6);
        display.setCursor(89,6);
        display.setTextColor(SSD1306_BLACK);
        display.print("2");
      }
      if (selected == sourceC) {
        //triangle shape to cut the solid box
        display.fillTriangle(118, 0, 128, 0, 128, 10, SSD1306_BLACK);
        display.fillCircle(66, 9, 3, SSD1306_WHITE); // fill for small box
        display.setTextSize(6);
        display.setCursor(89,6);
        display.setTextColor(SSD1306_BLACK);
        display.print("3");
      }
    // Average values of rx1, rx2, rx3 at the bottom
    display.setTextSize(1);
    display.setTextColor(SSD1306_WHITE);
    // RX1
    display.setCursor(3,56);
    display.print(avAA);
    //RX2
    display.setCursor(50,56);
    display.print(avBB);
    //RX3
    display.setCursor(100,56);
    display.print(avCC);
    display.display();
#endif
  yield();
}